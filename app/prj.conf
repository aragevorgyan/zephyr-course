## CMakeLists.txt
```
cmake_minimum_required(VERSION 3.20.0)

list(APPEND ZEPHYR_EXTRA_MODULES
     ${CMAKE_CURRENT_SOURCE_DIR}/../our-driver-module)

find_package(Zephyr REQUIRED HINTS $ENV{ZEPHYR_BASE})
project(my_zephyr_app)

target_sources(app PRIVATE src/main.c)
```

## Kconfig
```
config APP_HEARTBEAT_PERIOD_MS
	int "Application heartbeat period (ms)"
	range 100 2000
	default 500

menuconfig LED_SUBSYSTEM
	bool "LED Subsystem"
	default y

if LED_SUBSYSTEM

choice
	prompt "LED blink sleep time"
	default BLINK_SLEEP_1000MS

config BLINK_SLEEP_250MS
	bool "250ms (fast)"

config BLINK_SLEEP_500MS
	bool "500ms"

config BLINK_SLEEP_1000MS
	bool "1s (medium)"

config BLINK_SLEEP_2000MS
	bool "2s (slow)"

endchoice

config BLINK_SLEEP_TIME_MS
	int
	default 250 if BLINK_SLEEP_250MS
	default 500 if BLINK_SLEEP_500MS
	default 1000 if BLINK_SLEEP_1000MS
	default 2000 if BLINK_SLEEP_2000MS
	default 0

menuconfig LED_ADVANCED
	bool "Advanced LED settings"

if LED_ADVANCED

config LED_BRIGHTNESS
	int "LED brightness (0-100)"
	range 0 100
	default 100

config LED_FADE_DURATION_MS
	int "LED fade duration (ms)"
	range 0 5000
	default 500

menu "Expert settings"
	visible if LED_ADVANCED

config LED_DEBUG
	bool "Enable LED debugging"

config LED_CUSTOM_BLINK
	bool "Custom blink pattern"

endmenu

endif # LED_ADVANCED

endif # LED_SUBSYSTEM

source "Kconfig.zephyr"
```

## prj.conf
```kconfig
CONFIG_GPIO=y
CONFIG_LOG=y
CONFIG_SENSOR=y

CONFIG_SHELL=y
CONFIG_SHELL_BACKEND_SERIAL=y
CONFIG_SHELL_CMDS=y
```

## boards/native_sim.conf
```kconfig
CONFIG_UART_NATIVE_PTY_0_ON_STDINOUT=y
CONFIG_LOG_BACKEND_NATIVE_POSIX=n
```

## app.overlay
```dts
/*
 * On-board LED used by the our,driver sensor.
 * native_sim wires led0 to gpio0 pin 0, active high.
 */
/ {
	led_sensor: led_sensor {
		compatible = "our,driver";
		gpios = <&gpio0 0 GPIO_ACTIVE_HIGH>;
		status = "okay";
	};
};
```

## src/main.c
```c
#include <our_drivers/our_driver.h>

#include <stdlib.h>

#include <zephyr/device.h>
#include <zephyr/drivers/sensor.h>
#include <zephyr/kernel.h>
#include <zephyr/logging/log.h>
#include <zephyr/shell/shell.h>

#define SENSOR_LEVEL_MIN 0
#define SENSOR_LEVEL_MAX 100

LOG_MODULE_REGISTER(main, LOG_LEVEL_INF);

static const struct device *sensor_dev(void)
{
	return DEVICE_DT_GET_ANY(our_driver);
}

static int cmd_sensor_fetch(const struct shell *sh, size_t argc, char **argv)
{
	const struct device *dev = sensor_dev();
	int ret;

	ARG_UNUSED(argc);
	ARG_UNUSED(argv);

	if (!device_is_ready(dev)) {
		shell_error(sh, "sensor not ready");
		return -ENODEV;
	}

	ret = sensor_sample_fetch(dev);
	if (ret < 0) {
		shell_error(sh, "fetch failed: %d", ret);
		return ret;
	}

	shell_print(sh, "sample fetched");
	return 0;
}

static int cmd_sensor_read(const struct shell *sh, size_t argc, char **argv)
{
	const struct device *dev = sensor_dev();
	struct sensor_value val;
	int ret;

	ARG_UNUSED(argc);
	ARG_UNUSED(argv);

	if (!device_is_ready(dev)) {
		shell_error(sh, "sensor not ready");
		return -ENODEV;
	}

	ret = sensor_channel_get(dev, SENSOR_CHAN_LIGHT, &val);
	if (ret < 0) {
		shell_error(sh, "read failed: %d", ret);
		return ret;
	}

	shell_print(sh, "value: %d, level: %d", val.val1, val.val2);
	return 0;
}

static int cmd_sensor_set(const struct shell *sh, size_t argc, char **argv)
{
	const struct device *dev = sensor_dev();
	char *end = NULL;
	long level;
	int ret;

	if (argc < 2 || argv[1][0] == '\0') {
		shell_error(sh, "missing value");
		return -EINVAL;
	}

	level = strtol(argv[1], &end, 10);
	if (end == argv[1] || *end != '\0') {
		shell_error(sh, "invalid value");
		return -EINVAL;
	}

	if (level < SENSOR_LEVEL_MIN || level > SENSOR_LEVEL_MAX) {
		shell_error(sh, "value out of range (%d-%d)", SENSOR_LEVEL_MIN,
			    SENSOR_LEVEL_MAX);
		return -EINVAL;
	}

	if (!device_is_ready(dev)) {
		shell_error(sh, "sensor not ready");
		return -ENODEV;
	}

	ret = our_driver_set_level(dev, (int32_t)level);
	if (ret < 0) {
		shell_error(sh, "set failed: %d", ret);
		return ret;
	}

	shell_print(sh, "level set to %ld", level);
	return 0;
}

static int cmd_sensor_info(const struct shell *sh, size_t argc, char **argv)
{
	const struct device *dev = sensor_dev();

	ARG_UNUSED(argc);
	ARG_UNUSED(argv);

	shell_print(sh, "name: %s", dev->name);
	shell_print(sh, "ready: %s", device_is_ready(dev) ? "yes" : "no");
	return 0;
}

SHELL_STATIC_SUBCMD_SET_CREATE(sub_sensor,
	SHELL_CMD(fetch, NULL, "Call sensor_sample_fetch()", cmd_sensor_fetch),
	SHELL_CMD(read, NULL, "Call sensor_channel_get() and print the result", cmd_sensor_read),
	SHELL_CMD(info, NULL, "Print the device name and ready state", cmd_sensor_info),
	SHELL_CMD_ARG(set, NULL, "Set the driver level (0-100)", cmd_sensor_set, 2, 0),
	SHELL_SUBCMD_SET_END
);

SHELL_CMD_REGISTER(sensor, &sub_sensor, "LED sensor commands", NULL);

int main(void)
{
	const struct device *dev = sensor_dev();

	if (!device_is_ready(dev)) {
		LOG_ERR("LED sensor not ready");
		return 0;
	}

	LOG_INF("shell ready: sensor fetch | read | info | set <value>");
	k_sleep(K_FOREVER);
	return 0;
}
```

## src/main.cpp
```c
#include <zephyr/drivers/gpio.h>
#include <zephyr/kernel.h>
#include <zephyr/logging/log.h>

/* Heartbeat LED: alias app-led in app.overlay, which follows the board led0. */
#define LED_NODE DT_ALIAS(app_led)

static const struct gpio_dt_spec led = GPIO_DT_SPEC_GET(LED_NODE, gpios);

LOG_MODULE_REGISTER(main, LOG_LEVEL_INF);

int main(void)
{
    bool led_state = true;

    if (!gpio_is_ready_dt(&led)) {
        return 0;
    }

    if (gpio_pin_configure_dt(&led, GPIO_OUTPUT_ACTIVE) < 0) {
        return 0;
    }

    while (1) {
        if (gpio_pin_toggle_dt(&led) < 0) {
            return 0;
        }

        led_state = !led_state;
        LOG_INF("LED state: %s", led_state ? "ON" : "OFF");
        k_msleep(CONFIG_APP_HEARTBEAT_PERIOD_MS);
    }
    return 0;
}
```
