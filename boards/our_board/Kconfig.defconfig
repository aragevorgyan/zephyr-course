## boards/our_board/Kconfig.defconfig
```kconfig
# Our Board board configuration

# Copyright (c) 2017 Linaro Limited
# SPDX-License-Identifier: Apache-2.0

if BOARD_OUR_BOARD

configdefault NET_L2_ETHERNET
	default y

endif # BOARD_OUR_BOARD
```

## boards/our_board/board.yml
```yaml
board:
  name: our_board
  full_name: Our Board
  vendor: st
  socs:
    - name: stm32f429xx
```

## boards/scratch_board/Kconfig.defconfig
```kconfig
# SPDX-License-Identifier: Apache-2.0

if BOARD_SCRATCH_BOARD

config BOARD_LATE_INIT_HOOK
	default y

endif # BOARD_SCRATCH_BOARD
```

## boards/scratch_board/Kconfig.scratch_board
```kconfig
# SPDX-License-Identifier: Apache-2.0

config BOARD_SCRATCH_BOARD
	select SOC_STM32F429XX
```

## boards/scratch_board/board.yml
```yaml
board:
  name: scratch_board
  full_name: Scratch Board
  vendor: iomico
  socs:
    - name: stm32f429xx
```

## our-driver-module/drivers/our_driver/Kconfig
```kconfig
menuconfig OUR_DRIVER
	bool "Our Custom Driver"
	default y
	depends on DT_HAS_OUR_DRIVER_ENABLED
	depends on GPIO
	depends on SENSOR
	help
	  Enable the custom driver for the on-board LED.
```

## our-driver-module/dts/bindings/driver/our,driver.yaml
```yaml
description: On-board LED exposed through the sensor API.

compatible: "our,driver"

include: base.yaml

properties:
  gpios:
    type: phandle-array
    required: true
    description: GPIO specifier for the LED. Active level turns the LED on.
```
